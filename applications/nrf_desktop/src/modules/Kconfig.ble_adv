## applications/nrf_desktop/src/modules/Kconfig.ble_adv
```kconfig
#
# Copyright (c) 2026 Nordic Semiconductor ASA
#
# SPDX-License-Identifier: LicenseRef-Nordic-5-Clause
#

menuconfig DESKTOP_BLE_ADV
	bool "Bluetooth LE advertising module"
	depends on BT_PERIPHERAL
	depends on DESKTOP_BT_PERIPHERAL
	depends on CAF_BLE_COMMON_EVENTS
	depends on CAF_BLE_STATE
	depends on !CAF_BLE_ADV
	select BT_ADV_PROV
	help
	  Enable app-specific implementation of Bluetooth LE advertising module.

	  By default, nRF Desktop peripherals do not use direct advertising,
	  but use fast advertising and enable filter accept list.

if DESKTOP_BLE_ADV

config DESKTOP_BLE_ADV_PM_EVENTS
	bool "Power management events support"
	depends on CAF_PM_EVENTS
	default y

config DESKTOP_BLE_ADV_POWER_DOWN_ON_DISCONNECTION_REASON_0X15
	bool "Force power down on disconnection with reason 0x15"
	depends on DESKTOP_BLE_ADV_PM_EVENTS
	default y
	select CAF_FORCE_POWER_DOWN_EVENTS
	help
	  Force power down when a bonded peer disconnects with reason 0x15
	  (Remote Device Terminated due to Power Off). The module instantly
	  stops Bluetooth LE advertising and submits a force_power_down event.

	  nRF Desktop peripherals enable this option by default to avoid waking
	  up the HID host until user input is detected.

config DESKTOP_BLE_ADV_MODULE_SUSPEND_EVENTS
	bool "Module suspend/resume request events support"
	depends on CAF_MODULE_SUSPEND_EVENTS
	default y

config DESKTOP_BLE_ADV_SUSPEND_ON_READY
	bool "Automatically suspend module right after initialization"
	depends on DESKTOP_BLE_ADV_MODULE_SUSPEND_EVENTS

config DESKTOP_BLE_ADV_DIRECT_ADV
	bool "Advertise to bonded peer directly"
	default n
	depends on SETTINGS
	depends on CAF_BLE_BOND_SUPPORTED
	help
	  Device will use direct advertising if bonded. The device will not advertise directly
	  towards a central that uses Resolvable Private Address (RPA). The module does not read
	  the Central Address Resolution GATT characteristic of the central, so it does not know
	  if the remote device supports the address resolution of directed advertisements.

config DESKTOP_BLE_ADV_FAST_ADV
	bool "Period of fast advertising"
	default y

config DESKTOP_BLE_ADV_SLOW_INT_MIN
	hex "Minimum Advertising Interval during slow advertising (N * 0.625 milliseconds)"
	range 0x0020 0x4000
	default 0x00a0 # 100 ms
	help
	  Minimum Advertising Interval shall be less than or equal to the
	  Maximum Advertising Interval. The Minimum Advertising Interval and
	  Maximum Advertising Interval should not be the same value (as stated
	  in Bluetooth Core Spec 5.2, section 7.8.5)

config DESKTOP_BLE_ADV_SLOW_INT_MAX
	hex "Maximum Advertising Interval during slow advertising (N * 0.625 milliseconds)"
	range 0x0020 0x4000
	default 0x00f0 # 150 ms
	help
	  Minimum Advertising Interval shall be less than or equal to the
	  Maximum Advertising Interval. The Minimum Advertising Interval and
	  Maximum Advertising Interval should not be the same value (as stated
	  in Bluetooth Core Spec 5.2, section 7.8.5)

if DESKTOP_BLE_ADV_FAST_ADV

config DESKTOP_BLE_ADV_FAST_INT_MIN
	hex "Minimum Advertising Interval during fast advertising (N * 0.625 milliseconds)"
	range 0x0020 0x4000
	default 0x0030 # 30 ms
	help
	  Minimum Advertising Interval shall be less than or equal to the
	  Maximum Advertising Interval. The Minimum Advertising Interval and
	  Maximum Advertising Interval should not be the same value (as stated
	  in Bluetooth Core Spec 5.2, section 7.8.5)

config DESKTOP_BLE_ADV_FAST_INT_MAX
	hex "Maximum Advertising Interval during fast advertising (N * 0.625 milliseconds)"
	range 0x0020 0x4000
	default 0x0060 # 60 ms
	help
	  Minimum Advertising Interval shall be less than or equal to the
	  Maximum Advertising Interval. The Minimum Advertising Interval and
	  Maximum Advertising Interval should not be the same value (as stated
	  in Bluetooth Core Spec 5.2, section 7.8.5)

config DESKTOP_BLE_ADV_FAST_ADV_TIMEOUT
	int "Time of initial fast advertising [s]"
	default 30
	help
	  Device will initially advertise with shorter interval to enable quicker discovery by
	  hosts. After this time it will shift to normal cadence advertising.

endif

if !DESKTOP_BLE_ADV_FAST_ADV

config DESKTOP_BLE_ADV_FAST_INT_MIN
	hex
	default 0x0

config DESKTOP_BLE_ADV_FAST_INT_MAX
	hex
	default 0x0

config DESKTOP_BLE_ADV_FAST_ADV_TIMEOUT
	int
	default 0

endif

config DESKTOP_BLE_ADV_FILTER_ACCEPT_LIST
	bool "Filter accept list"
	default y
	select BT_FILTER_ACCEPT_LIST
	select BT_CTLR_FILTER_ACCEPT_LIST if HAS_BT_CTLR
	select BT_CTLR_PRIVACY if HAS_BT_CTLR
	help
	  If the used local identity already has bond, the device will filter
	  incoming scan response data requests and connection requests. In
	  that case, only the bonded peer can connect or request scan response
	  data.

config DESKTOP_BLE_ADV_GRACE_PERIOD
	bool "Grace period feature"
	depends on DESKTOP_BLE_ADV_PM_EVENTS
	default y if BT_ADV_PROV_SWIFT_PAIR
	help
	  The module advertises in grace period for predefined time before
	  advertising is turned off. During the grace period, the module
	  advertises modified payload.

	  The feature is used for example for devices that advertise Microsoft
	  Swift Pair data. To ensure users would not try to connect to a device
	  which is no longer available, Swift Pair vendor section is removed
	  and advertising is continued without Swift Pair data for additional
	  time before the advertising is stopped.

config DESKTOP_BLE_ADV_ROTATE_RPA
	bool "Rotate RPA together with advertising data"
	depends on BT_PRIVACY
	default y if BT_ADV_PROV_FAST_PAIR
	help
	  During active advertising, the module periodically triggers RPA
	  rotation combined with advertising data update. This prevents
	  automatic RPA rotations triggered by Zephyr in the background.

	  Synchronizing RPA rotation with advertising data update is needed if
	  an advertising provider uses a random value when generating data. In
	  that case lack of synchronization could lead to compromising privacy.

if DESKTOP_BLE_ADV_ROTATE_RPA

config DESKTOP_BLE_ADV_ROTATE_RPA_TIMEOUT
	int "RPA rotation timeout [s]"
	range 60 900 if BT_ADV_PROV_FAST_PAIR
	range 60 3600
	default 720
	help
	  Period of time in seconds between subsequent RPA rotations
	  triggered by module.

config DESKTOP_BLE_ADV_ROTATE_RPA_TIMEOUT_RAND
	int "RPA rotation timeout randomization [s]"
	range 10 50
	default 30
	help
	  Used RPA timeout value is randomized by subtracting a random value
	  that is between zero and randomization_timeout.

endif # DESKTOP_BLE_ADV_ROTATE_RPA

if !DESKTOP_BLE_ADV_ROTATE_RPA

config DESKTOP_BLE_ADV_ROTATE_RPA_TIMEOUT
	int
	default 0

config DESKTOP_BLE_ADV_ROTATE_RPA_TIMEOUT_RAND
	int
	default 0

endif # !DESKTOP_BLE_ADV_ROTATE_RPA

config DESKTOP_BLE_ADV_BLE_BOND_SUPPORTED
	bool
	default CAF_BLE_BOND_SUPPORTED
	help
	  Kconfig option used to inform that Bluetooth LE bond functionality is supported by the
	  application. If an application supports Bluetooth LE bond module, the Bluetooth LE
	  advertising module should not start advertising before the Bluetooth LE bond module is
	  initialized.

module = DESKTOP_BLE_ADV
module-str = BLE advertising
source "subsys/logging/Kconfig.template.log_config"

rsource "Kconfig.ble_adv.default"

endif # DESKTOP_BLE_ADV
```

## applications/nrf_desktop/src/modules/Kconfig.ble_adv.default
```kconfig
#
# Copyright (c) 2026 Nordic Semiconductor ASA
#
# SPDX-License-Identifier: LicenseRef-Nordic-5-Clause
#

# Default advertising data providers (BT_ADV_PROV_*) when DESKTOP_BLE_ADV is enabled.

if DESKTOP_BLE_ADV

config BT_ADV_PROV_FLAGS
	default y

config BT_ADV_PROV_GAP_APPEARANCE
	default y

config BT_ADV_PROV_DEVICE_NAME
	default y

config BT_ADV_PROV_DEVICE_NAME_PAIRING_MODE_ONLY
	default n
	help
	  nRF Desktop provides device name also outside of pairing mode. This is
	  done for backwards compatibility.

config BT_ADV_PROV_SWIFT_PAIR
	default y

config BT_ADV_PROV_FAST_PAIR
	default y if BT_FAST_PAIR

config BT_ADV_PROV_FAST_PAIR_SHOW_UI_PAIRING
	depends on BT_ADV_PROV_FAST_PAIR
	default n
	help
	  nRF Desktop peripheral supports one bond per local identity. Disable
	  the UI indication during Fast Pair not discoverable advertising to
	  prevent bonding failures.

config BT_ADV_PROV_TX_POWER
	default y

config DESKTOP_ADV_PROV_UUID16_ALL
	depends on (DESKTOP_HIDS_ENABLE || DESKTOP_BAS_ENABLE)
	default y

endif # DESKTOP_BLE_ADV
```

## applications/nrf_desktop/src/modules/Kconfig.ble_smp
```kconfig
#
# Copyright (c) 2026 Nordic Semiconductor ASA
#
# SPDX-License-Identifier: LicenseRef-Nordic-5-Clause
#

menuconfig DESKTOP_BLE_SMP_ENABLE
	bool "SMP over Bluetooth LE module"
	select CAF_BLE_SMP_TRANSFER_EVENTS
	depends on !CAF_BLE_SMP
	depends on CAF_BLE_STATE
	depends on MCUMGR_MGMT_NOTIFICATION_HOOKS
	depends on MCUMGR_GRP_IMG_UPLOAD_CHECK_HOOK
	depends on MCUMGR_GRP_IMG
	depends on MCUMGR_TRANSPORT_BT
	depends on BOOTLOADER_MCUBOOT
	help
	  This option enables SMP service allowing DFU over Bluetooth LE.

if DESKTOP_BLE_SMP_ENABLE

module = DESKTOP_BLE_SMP
module-str = ble smp
source "subsys/logging/Kconfig.template.log_config"

endif # DESKTOP_BLE_SMP_ENABLE
```
